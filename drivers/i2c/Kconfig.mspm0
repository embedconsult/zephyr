## drivers/i2c/Kconfig.mspm0
```kconfig
# Copyright (c) 2026 EmbedConsult
#
# SPDX-License-Identifier: Apache-2.0

config I2C_MSPM0
	bool "TI MSPM0 I2C driver"
	default y
	depends on DT_HAS_TI_MSPM0_I2C_ENABLED
	select PINCTRL
	select USE_MSPM0_DL_I2C
	help
	  Enable support for I2C on TI MSPM0 devices.
```

## dts/bindings/i2c/ti,mspm0-i2c.yaml
```yaml
description: TI MSPM0 I2C

compatible: "ti,mspm0-i2c"

include: [i2c-controller.yaml, pinctrl-device.yaml, base.yaml]

properties:
  reg:
    required: true

  interrupts:
    required: true

  pinctrl-0:
    required: true

  pinctrl-names:
    required: true

  clk-div:
    type: int
    default: 1
    enum:
      - 1
      - 2
      - 3
      - 4
      - 5
      - 6
      - 7
      - 8
    description: Clock divider selection value.
```
